## sdkconfig.defaults
```kconfig
CONFIG_FREERTOS_HZ=1000
CONFIG_AUTOSTART_ARDUINO=y
CONFIG_ESP_DEFAULT_CPU_FREQ_MHZ_240=y
CONFIG_ESP_DEFAULT_CPU_FREQ_MHZ=240
# CONFIG_ESP_DEFAULT_CPU_FREQ_MHZ_160 is not set
CONFIG_ESP32S3_DEFAULT_CPU_FREQ_240=y
CONFIG_ESP32S3_DEFAULT_CPU_FREQ_MHZ=240
# CONFIG_ESP32S3_DEFAULT_CPU_FREQ_160 is not set
CONFIG_ESPTOOLPY_FLASHMODE_QIO=y
CONFIG_ESPTOOLPY_FLASHMODE="qio"
CONFIG_ESPTOOLPY_FLASHFREQ_80M=y
CONFIG_ESPTOOLPY_FLASHFREQ="80m"
CONFIG_ESPTOOLPY_FLASHSIZE_8MB=y
CONFIG_ESPTOOLPY_FLASHSIZE="8MB"
CONFIG_PARTITION_TABLE_CUSTOM=y
CONFIG_PARTITION_TABLE_CUSTOM_FILENAME="huge_app.csv"
CONFIG_PARTITION_TABLE_FILENAME="huge_app.csv"
CONFIG_PARTITION_TABLE_OFFSET=0x8000
CONFIG_ARDUHAL_PARTITION_SCHEME_HUGE_APP=y
CONFIG_ARDUHAL_PARTITION_SCHEME="huge_app"
CONFIG_SPIRAM=y
CONFIG_SPIRAM_MODE_OCT=y
CONFIG_SPIRAM_SPEED_80M=y
CONFIG_SPIRAM_USE_MALLOC=y
CONFIG_SPIRAM_TRY_ALLOCATE_WIFI_LWIP=y
CONFIG_SPIRAM_MALLOC_ALWAYSINTERNAL=32768
CONFIG_SPIRAM_MALLOC_RESERVE_INTERNAL=65536
CONFIG_COMPILER_CXX_EXCEPTIONS=y
CONFIG_COMPILER_CXX_EXCEPTIONS_EMG_POOL_SIZE=0
CONFIG_COMPILER_OPTIMIZATION_SIZE=y
# CONFIG_COMPILER_OPTIMIZATION_DEBUG is not set
# CONFIG_COMPILER_OPTIMIZATION_PERF is not set
# CONFIG_COMPILER_OPTIMIZATION_NONE is not set
# CONFIG_MBEDTLS_INTERNAL_MEM_ALLOC is not set
CONFIG_MBEDTLS_EXTERNAL_MEM_ALLOC=y
# CONFIG_MBEDTLS_DEFAULT_MEM_ALLOC is not set
CONFIG_MBEDTLS_DYNAMIC_BUFFER=y
CONFIG_MBEDTLS_DYNAMIC_FREE_CONFIG_DATA=y
CONFIG_MBEDTLS_DYNAMIC_FREE_CA_CERT=y
CONFIG_MBEDTLS_PSK_MODES=y
CONFIG_MBEDTLS_KEY_EXCHANGE_PSK=y
CONFIG_MBEDTLS_KEY_EXCHANGE_RSA_PSK=y
CONFIG_MBEDTLS_KEY_EXCHANGE_ECDHE_PSK=y

# USB Audio Class V1.7: Windows-first speaker-only device.
# macOS mode is intentionally left disabled because Espressif documents that
# enabling it can make the device unrecognizable by Windows.
CONFIG_UAC_TUSB_VID=0x303A
CONFIG_UAC_TUSB_PID=0x8000
CONFIG_UAC_TUSB_MANUFACTURER="RASPIAUDIO"
CONFIG_UAC_TUSB_PRODUCT="Muse Radio"
CONFIG_UAC_TUSB_SERIAL_NUM="MuseRadioDisplayA441S2"
CONFIG_TINYUSB_RHPORT_FS=y
# CONFIG_TINYUSB_RHPORT_HS is not set
# CONFIG_USB_DEVICE_UAC_AS_PART is not set
CONFIG_UAC_SPEAKER_CHANNEL_NUM=2
CONFIG_UAC_MIC_CHANNEL_NUM=0
CONFIG_UAC_SAMPLE_RATE=44100
CONFIG_UAC_SPK_INTERVAL_MS=10
CONFIG_UAC_MIC_INTERVAL_MS=10
CONFIG_UAC_SPK_NEW_PLAY_INTERVAL=100
# CONFIG_UAC_SUPPORT_MACOS is not set
CONFIG_UAC_TINYUSB_TASK_PRIORITY=6
CONFIG_UAC_TINYUSB_TASK_CORE=1
CONFIG_UAC_SPK_TASK_PRIORITY=6
CONFIG_UAC_SPK_TASK_CORE=1
```
